/*
 * Re-enables SPI
 */

/dts-v1/;
/plugin/;

/ {
    compatible = "brcm,bcm2835", "brcm,bcm2836", "brcm,bcm2708", "brcm,bcm2709";
    /* enable spi-dev for spi0.0 */
    fragment@0 {
        target = <&spi0>;
        __overlay__ {
            status = "okay";
            spidev@0{
                status = "enabled";
            };
        };
    };

    /* enable spi-dev for spi0.1 */
    fragment@1 {
        target = <&spi0>;
        __overlay__ {
            status = "okay";
            spidev@1{
                status = "enabled";
            };
        };
    };
};
